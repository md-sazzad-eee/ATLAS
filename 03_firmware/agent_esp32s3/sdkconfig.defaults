## 03_firmware/agent_esp32s3/sdkconfig.defaults
```kconfig
CONFIG_ESPTOOLPY_FLASHSIZE_8MB=y
CONFIG_SPIRAM=y
CONFIG_SPIRAM_MODE_OCT=y
CONFIG_FREERTOS_HZ=1000
CONFIG_ESP_CONSOLE_USB_SERIAL_JTAG=y
CONFIG_ESP_TASK_WDT_TIMEOUT_S=2
CONFIG_ESP_INT_WDT=y
CONFIG_LWIP_SO_RCVBUF=y
CONFIG_PARTITION_TABLE_SINGLE_APP_LARGE=y
```

## 03_firmware/agent_esp32s3/src/Kconfig.projbuild
```kconfig
menu "ATLAS Agent"
    config ATLAS_AGENT_SCOUT
        bool "This agent is the Scout (Pi Zero 2 W camera module fitted)"
        default y
    config ATLAS_WIFI_SSID
        string "Carrier Wi-Fi SSID"
        default "atlas-carrier"
    config ATLAS_WIFI_PASS
        string "Carrier Wi-Fi password"
        default "change-me-please"
    config ATLAS_CARRIER_IP
        string "Carrier (agent_bridge) IPv4 address"
        default "192.168.50.1"
    config ATLAS_CARRIER_PORT
        int "agent_bridge UDP port for this agent (scout 47001, research 47002)"
        default 47001
    config ATLAS_SENS_GAIN_X1000
        int "Research sensor gain x1000 (value = gain * V + offset)"
        default 1000
endmenu
```
